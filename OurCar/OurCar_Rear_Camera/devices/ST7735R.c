/*!
 *     COPYRIGHT NOTICE
 *     Copyright (c) 2013,山外科技
 *     All rights reserved.
 *     技术讨论：山外初学论坛 http://www.vcan123.com
 *
 *     除注明出处外，以下所有内容版权均属山外科技所有，未经允许，不得用于商业用途，
 *     修改内容时必须保留山外科技的版权声明。
 *
 * @file       VCAN_LCD_ST7735R.c
 * @brief      LCD 函数库
 * @author     山外科技
 * @version    v5.1
 * @date       2014-04-26
 */


#include "common.h"
#include "ST7735R.h"




//常用ASCII表
//偏移量32
//ASCII字符集
//偏移量32
//大小:8*16
unsigned char const ascii_8x16[1536] =  //96X16=1536      //ascii字符范围为[32,127] = 96个字符,每个字符要用16个字节来表示  所以有96X16=1536个字节
{
    0x00, 0x00, 0x00, 0x00, 0x00, 0x00, 0x00, 0x00, 0x00, 0x00, 0x00, 0x00, 0x00, 0x00, 0x00, 0x00,
    0x00, 0x00, 0x18, 0x3C, 0x3C, 0x3C, 0x18, 0x18, 0x18, 0x00, 0x18, 0x18, 0x00, 0x00, 0x00, 0x00,
    0x00, 0x66, 0x66, 0x66, 0x24, 0x00, 0x00, 0x00, 0x00, 0x00, 0x00, 0x00, 0x00, 0x00, 0x00, 0x00,
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    0x00, 0x00, 0x00, 0x00, 0x10, 0x38, 0x6C, 0xC6, 0xC6, 0xC6, 0xFE, 0x00, 0x00, 0x00, 0x00, 0x00
};


uint16_t  st7735r_h   = ST7735R_H;
uint16_t  st7735r_w   = ST7735R_W;
uint8_t   st7735r_dir = ST7735R_DIR_DEFAULT;





/*!
 *  @brief      LCD初始化
 *  @since      v5.0
 */
void LCD_init(void)
{
    Site_t site = {0, 0};
    Size_t size ;

    LCD_ST7735R_init();                             //初始化LCD


    //由于初始化的时候进行 屏幕方向 选择，因而初始化完成后，才获取宽高
    size.W = ST7735R_W;
    size.H = ST7735R_H;

    LCD_rectangle(site, size, BCOLOUR);     //初始化背景
}

/*!
 *  @brief      显示实心矩形
 *  @param      site    左上角坐标
 *  @param      size    矩形大小
 *  @param      rgb565  颜色
 *  @since      v5.0
*  Sample usage:        Site_t site = {10,20};   //x = 10 ,y = 20
                        Size_t size = {50,60};  // W = 50 ,H = 60
                        LCD_rectangle(site, size, RED);
 */
void LCD_rectangle(Site_t site, Size_t size, uint16_t rgb565)
{
    uint32 n, temp;

    LCD_PTLON(site, size);              //开窗

    temp = (uint32)size.W * size.H;
    LCD_RAMWR();                        //写内存
    for(n = 0; n < temp; n++)
    {
        LCD_WR_DATA( rgb565 );          //写数据
    }
}

/*!
 *  @brief      画点
 *  @param      site    左上角坐标
 *  @param      rgb565  颜色
 *  @since      v5.0
*  Sample usage:        Site_t site = {10,20};   //x = 10 ,y = 20
                        LCD_point(site, RED);
 */
void LCD_point(Site_t site, uint16_t rgb565)
{
    Size_t size = {1, 1};
    LCD_PTLON(site, size);
    LCD_ST7735R_WR_8CMD(0x2c);                        //写内存
    LCD_WR_DATA(rgb565);                //写数据
}

/*!
 *  @brief      显示字符
 *  @param      site    左上角坐标
 *  @param      ascii   字符
 *  @param      Color   字体颜色
 *  @param      bkColor 背景颜色
 *  @since      v5.0
*  Sample usage:        Site_t site = {10,20};   //x = 10 ,y = 20
                        LCD_char(site,'0', BLUE,RED);
 */
void LCD_char(Site_t site, uint8_t ascii, uint16_t Color, uint16_t bkColor)
{
#define MAX_CHAR_POSX (ST7735R_W-8)
#define MAX_CHAR_POSY (ST7735R_H-16)

    uint8_t temp, t, pos;
    Size_t size = {8, 16};

    if(site.x > MAX_CHAR_POSX || site.y > MAX_CHAR_POSY)
    {
        return;
    }

    LCD_PTLON(site, size);

    LCD_RAMWR();                    //写内存

    for (pos = 0; pos < 16; pos++)
    {
        temp = ascii_8x16[((ascii-0x20)*16)+pos];

        for(t = 0; t < 8; t++)
        {

            if(temp & 0x80)
            {
                LCD_WR_DATA(Color);
            }
            else
            {
                LCD_WR_DATA(bkColor);
            }
            temp <<= 1;
        }
    }
    return;
#undef MAX_CHAR_POSX
#undef MAX_CHAR_POSY
}

/*!
 *  @brief      显示字符串
 *  @param      site    左上角坐标
 *  @param      Str     字符串地址
 *  @param      Color   字体颜色
 *  @param      bkColor 背景颜色
 *  @since      v5.0
*  Sample usage:        Site_t site = {10,20};   //x = 10 ,y = 20
                        LCD_str(site,"www.vcan123.com", BLUE,RED);
 */
void LCD_str(Site_t site, uint8_t *Str, uint16_t Color, uint16_t bkColor)
{
#define MAX_CHAR_POSX (ST7735R_W-8)
#define MAX_CHAR_POSY (ST7735R_H-16)
    while(*Str != '\0')
    {
        if(site.x > MAX_CHAR_POSX )
        {
            //换行
            site.x = 0;
            site.y += 16;
        }
        if(site.y > MAX_CHAR_POSY )
        {
            //一屏
            site.y = 0;
            site.x = 0;
        }

        LCD_char(site, *Str, Color, bkColor);
        site.x += 8;
        Str ++ ;
    }
#undef MAX_CHAR_POSX
#undef MAX_CHAR_POSY
}

/*!
 *  @brief      显示数字
 *  @param      site    左上角坐标
 *  @param      num     数字
 *  @param      Color   字体颜色
 *  @param      bkColor 背景颜色
 *  @since      v5.0
*  Sample usage:        Site_t site = {10,20};   //x = 10 ,y = 20
                        LCD_num(site,123, BLUE,RED);
 */
void LCD_num(Site_t site, uint32 num, uint16_t Color, uint16_t bkColor)
{
    uint32 res = num;
    uint8_t t = 0;
    Site_t sitetemp;
    sitetemp.y = site.y;

    if( num == 0 )
    {
        LCD_char(site, '0', Color, bkColor);
        return;
    }
    while( res )  /*得到数字长度t*/
    {
        res /= 10;
        t++;
    }

    while(num)
    {
        sitetemp.x = site.x + (8 * (t--) - 8);
        LCD_char(sitetemp, (num % 10) + '0', Color, bkColor);
        num /= 10 ;
    }
}

/*!
 *  @brief      显示数字（清空多余的位）
 *  @param      site            左上角坐标
 *  @param      num             数字
 *  @param      max_num_bit     最大的位数
 *  @param      Color           字体颜色
 *  @param      bkColor         背景颜色
 *  @since      v5.0
*  Sample usage:        Site_t site = {10,20};   //x = 10 ,y = 20
                        LCD_num_BC(site,123,5, BLUE,RED);
 */
void LCD_num_BC(Site_t site, uint32 num, uint8_t max_num_bit, uint16_t Color, uint16_t bkColor)
{
    uint32 res = num;
    uint8_t t = 0;
    Site_t sitetemp;
    Size_t size;

    sitetemp.y = site.y;

    if( num == 0 )
    {
        LCD_char(site, '0', Color, bkColor);

        site.x += 8;
        size.H  = 16;
        size.W  = 8 * (max_num_bit - 1);
        LCD_rectangle(site, size, bkColor);

        return;
    }
    while( res )            /*得到数字长度t*/
    {
        res /= 10;
        t++;
    }
    if(t >= max_num_bit )    //限制最大长度
    {
        t = max_num_bit;
    }

    res = t;

    while( t != 0 )
    {
        sitetemp.x = site.x + (8 * (t--) - 8);
        LCD_char(sitetemp, (num % 10) + '0', Color, bkColor);
        num /= 10 ;
    }

    if(res != max_num_bit )
    {
        size.W = 8 * (max_num_bit - res);
        site.x += (8 * res);
        size.H  = 16;
        LCD_rectangle(site, size, bkColor);
    }
}

/*!
 *  @brief      灰度图像显示
 *  @param      site            左上角坐标
 *  @param      size            显示图像大小
 *  @param      img             图像地址
 *  @since      v5.0
 *  Sample usage:       Site_t site = {10,20};      //x = 10 ,y = 20
                        Size_t size = {320,240};    //W = 320,H = 240
                        LCD_Img_gray(site, size, img);
 */
void LCD_Img_gray(Site_t site, Size_t size, uint8_t *img)
{
    uint32     total = (size.H * size.W);
    uint16_t     imgtemp;
    uint8_t     *pimg = (uint8_t *)img;

    LCD_PTLON(site, size);                      //开窗
    LCD_RAMWR();                                //写内存

    while(total--)
    {
        imgtemp     = (uint16_t) * (pimg++);
        imgtemp = GRAY_2_RGB565(imgtemp);
        LCD_WR_DATA( imgtemp );               //写图像数据
    }
}

/*!
 *  @brief      缩放灰度图像显示
 *  @param      site            左上角坐标
 *  @param      size            显示图像大小
 *  @param      img             图像地址
 *  @param      imgsize         图像大小
 *  @since      v5.0
 *  Sample usage:       Site_t site = {10,20};          //x = 10 ,y = 20
                        Size_t size = {80,60};          //W = 80,H = 60
                        Size_t imgsize = {320,240};     //W = 320,H = 240
                        LCD_Img_gray_Z(site, size, img,imgsize);
 */
void LCD_Img_gray_Z(Site_t site, Size_t size, uint8_t *img, Size_t imgsize)
{

    uint32 temp, tempY;
    uint16_t x, y;
    uint16_t X, Y;
    uint8_t *pimg = (uint8_t *)img;
    uint16_t rgb;

    LCD_PTLON(site, size);                      //开窗

    LCD_RAMWR();                                //写内存

    for(y = 0; y < size.H; y++)
    {
        Y = ( (  y * imgsize.H   ) / size.H) ;
        tempY = Y * imgsize.W ;

        for(x = 0; x < size.W; x++)
        {
            X = ( x * imgsize.W  ) / size.W ;
            temp = tempY + X;
            rgb = GRAY_2_RGB565(pimg[temp]);    //
            LCD_WR_DATA(rgb);
        }
    }
}



void LCD_Img_Binary(Site_t site, Size_t size, uint8_t *img)
{
    uint32     total = (size.H * size.W) / 8;
    uint8_t     imgtemp;
    uint8_t       bitindex;
    uint8_t     *pimg = (uint8_t *)img;

    LCD_PTLON(site, size);                      //开窗

    LCD_RAMWR();                                //写内存

    while(total--)
    {
        imgtemp     = *(pimg++);
        bitindex    = 8;
        while(bitindex--)
        {
            if( imgtemp & (0x01 << bitindex) )
            {
                LCD_WR_DATA( BINARY_COLOR );      //写图像数据
            }
            else
            {
                LCD_WR_DATA(  BINARY_BGCOLOR  );      //写图像数据
            }
        }
    }
}

void LCD_Img_Binary_Z(Site_t site, Size_t size, uint8_t *img, Size_t imgsize)
{

    uint32 temp, tempY;
    uint16_t x, y;
    uint16_t X, Y;
    uint8_t *pimg = (uint8_t *)img;

    LCD_PTLON(site, size);                      //开窗

    LCD_RAMWR();                                //写内存

    for(y = 0; y < size.H; y++)
    {
        Y = ( (  y * imgsize.H  ) / size.H) ;
        tempY = Y * imgsize.W ;

        for(x = 0; x < size.W; x++)
        {
            X = (( x * imgsize.W  ) / size.W) ;
            temp = tempY + X;
            if( (pimg[temp>>3] & (1 << (7 - (temp & 0x07))) ) == 0  )
            {
                LCD_WR_DATA( BINARY_BGCOLOR );        //写图像数据
            }
            else
            {
                LCD_WR_DATA( BINARY_COLOR );      //写图像数据
            }
        }
    }
}

void LCD_wave(Site_t site,Size_t size,uint8_t *img,uint8_t maxval,uint16_t Color ,uint16_t bkColor)
{

    uint8_t h;
    uint16_t y = site.y + size.H - 1;

    LCD_rectangle(site, size,bkColor);
    site.x += size.W;
    img  += (size.W - 1);
    while(size.W --)
    {
        if(*img >= maxval )
        {
            h = size.H - 1;
        }
        else
        {
            h = ((*img )* size.H )/maxval;
        }
        site.y = y - h ;
        site.x--;
        img --;
        LCD_point(site, Color);
    }
}

void LCD_wave_display(Site_t site,Size_t size,uint8_t *img,uint8_t maxval,uint16_t Color)
{

    uint8_t h;
    uint16_t y = site.y + size.H - 1;

    site.x += size.W;
    img  += (size.W - 1);
    while(size.W --)
    {
        if(*img >= maxval )
        {
            h = size.H - 1;
        }
        else
        {
            h = ((*img )* size.H )/maxval;
        }
        site.y = y - h ;
        site.x--;
        img --;
        LCD_point(site, Color);
    }
}


void LCD_ST7735R_wr_data(uint8_t data)
{
    LCD_ST7735R_RD_OUT = 1;
    LCD_ST7735R_RS_OUT = 1;
    LCD_ST7735R_CS_OUT = 0;

    PCout(0)=(data&0x01);\
		PCout(1)=(data>>1&0x01);\
		PCout(2)=(data>>2&0x01);\
		PCout(3)=(data>>3&0x01);\
		PCout(4)=(data>>4&0x01);\
		PCout(5)=(data>>5&0x01);\
		PCout(6)=(data>>6&0x01);\
		PCout(7)=(data>>7&0x01);\

    ST7735R_DELAY();

    LCD_ST7735R_WR_OUT = 0;
    LCD_ST7735R_WR_OUT = 1;
    LCD_ST7735R_CS_OUT = 1;
}

void LCD_ST7735R_wr_cmd(uint8_t cmd)
{
    LCD_ST7735R_RD_OUT = 1;
    LCD_ST7735R_RS_OUT = 0;
    LCD_ST7735R_CS_OUT = 0;

    PCout(0)=(cmd&0x01);\
		PCout(1)=(cmd>>1&0x01);\
		PCout(2)=(cmd>>2&0x01);\
		PCout(3)=(cmd>>3&0x01);\
		PCout(4)=(cmd>>4&0x01);\
		PCout(5)=(cmd>>5&0x01);\
		PCout(6)=(cmd>>6&0x01);\
		PCout(7)=(cmd>>7&0x01);\

    ST7735R_DELAY();
    LCD_ST7735R_WR_OUT = 0;
    LCD_ST7735R_WR_OUT = 1;
    LCD_ST7735R_CS_OUT = 1;
}

/*!
 *  @brief      LCD_ST7735R初始化
 *  @since      v5.0
 */
void    LCD_ST7735R_init(void)
{
    uint8_t n ;

    for(n = 0; n < 8; n++)
    {
			GPIO_QuickInit(HW_GPIOC, n, kGPIO_Mode_OOD); 
			PORT_PinPullConfig(HW_GPIOC, n, kPullUp);
			PORT_PinOpenDrainConfig(HW_GPIOC, n, ENABLE);
    }
		PORT_PinMuxConfig(HW_GPIOC, LCD_ST7735R_WR, kPinAlt1);
		PORT_PinMuxConfig(HW_GPIOC, LCD_ST7735R_RD, kPinAlt1);
		PORT_PinMuxConfig(HW_GPIOC, LCD_ST7735R_CS, kPinAlt1);
		PORT_PinMuxConfig(HW_GPIOC, LCD_ST7735R_RS, kPinAlt1);

	
    GPIO_QuickInit(HW_GPIOC, LCD_ST7735R_WR, kGPIO_Mode_OOD); 
	  PORT_PinPullConfig(HW_GPIOC, LCD_ST7735R_WR, kPullUp);
	  PORT_PinOpenDrainConfig(HW_GPIOC, LCD_ST7735R_WR, ENABLE);
	  GPIO_WriteBit(HW_GPIOC, LCD_ST7735R_WR, 0);
    GPIO_QuickInit(HW_GPIOC, LCD_ST7735R_RD, kGPIO_Mode_OOD); 
	  PORT_PinPullConfig(HW_GPIOC, LCD_ST7735R_RD, kPullUp);
	  PORT_PinOpenDrainConfig(HW_GPIOC, LCD_ST7735R_RD, ENABLE);
	  GPIO_WriteBit(HW_GPIOC, LCD_ST7735R_RD, 1);
    GPIO_QuickInit(HW_GPIOC, LCD_ST7735R_CS, kGPIO_Mode_OOD); 
	  PORT_PinPullConfig(HW_GPIOC, LCD_ST7735R_CS, kPullUp);
	  PORT_PinOpenDrainConfig(HW_GPIOC, LCD_ST7735R_CS, ENABLE);
	  GPIO_WriteBit(HW_GPIOC, LCD_ST7735R_CS, 1);
    GPIO_QuickInit(HW_GPIOC, LCD_ST7735R_RS, kGPIO_Mode_OOD); 
	  PORT_PinPullConfig(HW_GPIOC, LCD_ST7735R_RS, kPullUp);
	  PORT_PinOpenDrainConfig(HW_GPIOC, LCD_ST7735R_RS, ENABLE);
	  GPIO_WriteBit(HW_GPIOC, LCD_ST7735R_RS, 0);
    GPIO_QuickInit(HW_GPIOC, LCD_ST7735R_RST, kGPIO_Mode_OOD); 
	  PORT_PinPullConfig(HW_GPIOC, LCD_ST7735R_RST, kPullUp);
	  PORT_PinOpenDrainConfig(HW_GPIOC, LCD_ST7735R_RST, ENABLE);
	  GPIO_WriteBit(HW_GPIOC, LCD_ST7735R_RST, 0);

    //初始化总线
    LCD_ST7735R_RST_OUT = 0;
    ST7735R_DELAY();
    LCD_ST7735R_RST_OUT = 1;
    ST7735R_DELAY_MS(500);      //上电给足够时间

    LCD_ST7735R_WR_8CMD(0x11);           //Sleep out   退出睡眠模式
    ST7735R_DELAY_MS(120);      //Delay 120ms
    //------------------------------------ST7735R Frame Rate-----------------------------------------//
    /* Set the frame frequency of the full colors normal mode. */
    LCD_ST7735R_WR_8CMD(0xB1);     //In Normal Mode (Full Colors)    全屏模式
    LCD_ST7735R_WR_8DATA(0x05);    //设置 RTNA Set 1-line  Period  一行周期
    LCD_ST7735R_WR_8DATA(0x3A);    //设置 FPA: Front Porch
    LCD_ST7735R_WR_8DATA(0x3A);    //设置 BPA: Back Porch
    //Frame rate=fosc/((RTNA x 2 + 40) x (LINE + FPA + BPA +2))
    //其中 fosc = 850kHz

    /* Set the frame frequency of the Idle mode.  */
    LCD_ST7735R_WR_8CMD(0xB2);     //In Idle Mode (8-colors)
    LCD_ST7735R_WR_8DATA(0x05);
    LCD_ST7735R_WR_8DATA(0x3A);
    LCD_ST7735R_WR_8DATA(0x3A);

    /* Set the frame frequency of the Partial mode/ full colors. */
    LCD_ST7735R_WR_8CMD(0xB3);
    LCD_ST7735R_WR_8DATA(0x05);
    LCD_ST7735R_WR_8DATA(0x3A);
    LCD_ST7735R_WR_8DATA(0x3A);
    LCD_ST7735R_WR_8DATA(0x05);
    LCD_ST7735R_WR_8DATA(0x3A);
    LCD_ST7735R_WR_8DATA(0x3A);

    //------------------------------------End ST7735R Frame Rate-----------------------------------------//
    LCD_ST7735R_WR_8CMD(0xB4);   //Display Inversion Control  显示反转控制

    LCD_ST7735R_WR_8DATA(0x07);  //LCD_ST7735R_WR_8DATA(0x03); 原来为3，改为7
    // 低三位从高到低，分别为  full colors normal mode 、Idle mode 、
    // full Colors partial mode  的 点反转 或 列反转 ，1为列反转

    LCD_ST7735R_WR_8CMD(0xC0);   //Power Control Setting  电源控制设置
    LCD_ST7735R_WR_8DATA(0x28);
    LCD_ST7735R_WR_8DATA(0x08);
    LCD_ST7735R_WR_8DATA(0x84);
    LCD_ST7735R_WR_8CMD(0xC1);
    LCD_ST7735R_WR_8DATA(0XC0);
    LCD_ST7735R_WR_8CMD(0xC2);
    LCD_ST7735R_WR_8DATA(0x0C);
    LCD_ST7735R_WR_8DATA(0x00);
    LCD_ST7735R_WR_8CMD(0xC3);
    LCD_ST7735R_WR_8DATA(0x8C);
    LCD_ST7735R_WR_8DATA(0x2A);
    LCD_ST7735R_WR_8CMD(0xC4);
    LCD_ST7735R_WR_8DATA(0x8A);
    LCD_ST7735R_WR_8DATA(0xEE);
    //---------------------------------End ST7735R Power Sequence-------------------------------------//
    LCD_ST7735R_WR_8CMD(0xC5);   //  VCOM 电压配置
    LCD_ST7735R_WR_8DATA(0x0C); //  -0.725
    //------------------------------------ST7735R Gamma Sequence-----------------------------------------//
    LCD_ST7735R_WR_8CMD(0xE0);
    LCD_ST7735R_WR_8DATA(0x05);
    LCD_ST7735R_WR_8DATA(0x1A);
    LCD_ST7735R_WR_8DATA(0x0C);
    LCD_ST7735R_WR_8DATA(0x0E);
    LCD_ST7735R_WR_8DATA(0x3A);
    LCD_ST7735R_WR_8DATA(0x34);
    LCD_ST7735R_WR_8DATA(0x2D);
    LCD_ST7735R_WR_8DATA(0x2F);
    LCD_ST7735R_WR_8DATA(0x2D);
    LCD_ST7735R_WR_8DATA(0x2A);
    LCD_ST7735R_WR_8DATA(0x2F);
    LCD_ST7735R_WR_8DATA(0x3C);
    LCD_ST7735R_WR_8DATA(0x00);
    LCD_ST7735R_WR_8DATA(0x01);
    LCD_ST7735R_WR_8DATA(0x02);
    LCD_ST7735R_WR_8DATA(0x10);
    LCD_ST7735R_WR_8CMD(0xE1);
    LCD_ST7735R_WR_8DATA(0x04);
    LCD_ST7735R_WR_8DATA(0x1B);
    LCD_ST7735R_WR_8DATA(0x0D);
    LCD_ST7735R_WR_8DATA(0x0E);
    LCD_ST7735R_WR_8DATA(0x2D);
    LCD_ST7735R_WR_8DATA(0x29);
    LCD_ST7735R_WR_8DATA(0x24);
    LCD_ST7735R_WR_8DATA(0x29);
    LCD_ST7735R_WR_8DATA(0x28);
    LCD_ST7735R_WR_8DATA(0x26);
    LCD_ST7735R_WR_8DATA(0x31);
    LCD_ST7735R_WR_8DATA(0x3B);
    LCD_ST7735R_WR_8DATA(0x00);
    LCD_ST7735R_WR_8DATA(0x00);
    LCD_ST7735R_WR_8DATA(0x03);
    LCD_ST7735R_WR_8DATA(0x12);
    //------------------------------------End ST7735R Gamma Sequence-----------------------------------------//

    LCD_ST7735R_WR_8CMD(0x3A); //65k mode
    LCD_ST7735R_WR_8DATA(0x05);
    LCD_ST7735R_WR_8CMD(0x29); //开显示 Display on
    LCD_ST7735R_WR_8CMD(0x2c); //

    LCD_ST7735R_dir(st7735r_dir);

}

/*!
 *  @brief      设置ST7735R GRAM指针扫描方向
 *  @param      option    方向选择（正看（焊接排线在下面） 为 0 ，90度为1，180度为2，270度为2）
 *  @since      v5.0
 */
void LCD_ST7735R_dir(uint8_t option)
{


    st7735r_dir = option;
    switch(option)
    {
    case 0:
        LCD_ST7735R_WR_8CMD(0x36); // 内存数据访问控制  MX 列地址顺序, MY 行地址顺序 ，MV 行列交换 ，ML 垂直刷新顺序 ,RGB  RGB-BGA顺序
        LCD_ST7735R_WR_8DATA(0xc8);//0xc8  0xA8 0x08 0x68

        LCD_ST7735R_WR_8CMD(0x2a);
        LCD_ST7735R_WR_8DATA(0x00);
        LCD_ST7735R_WR_8DATA(0x00);
        LCD_ST7735R_WR_8DATA(0x00);
        LCD_ST7735R_WR_8DATA(128);

        LCD_ST7735R_WR_8CMD(0x2B);
        LCD_ST7735R_WR_8DATA(0x00);
        LCD_ST7735R_WR_8DATA(50);
        LCD_ST7735R_WR_8DATA(0x00);
        LCD_ST7735R_WR_8DATA(128+50);

        st7735r_h   = ST7735R_H;
        st7735r_w   = ST7735R_W;
        break;
    case 1:
        LCD_ST7735R_WR_8CMD(0x36); // 内存数据访问控制  MX 列地址顺序, MY 行地址顺序 ，MV 行列交换 ，ML 垂直刷新顺序 ,RGB  RGB-BGA顺序
        LCD_ST7735R_WR_8DATA(0xA8);//0xc8  0xA8 0x08 0x68

        LCD_ST7735R_WR_8CMD(0x2a);
        LCD_ST7735R_WR_8DATA(0x00);
        LCD_ST7735R_WR_8DATA(0x03);
        LCD_ST7735R_WR_8DATA(0x00);
        LCD_ST7735R_WR_8DATA(0x82);

        LCD_ST7735R_WR_8CMD(0x2B);
        LCD_ST7735R_WR_8DATA(0x00);
        LCD_ST7735R_WR_8DATA(0x02);
        LCD_ST7735R_WR_8DATA(0x00);
        LCD_ST7735R_WR_8DATA(0x81);

        st7735r_h   = ST7735R_W;
        st7735r_w   = ST7735R_H;
        break;
    case 2:
        LCD_ST7735R_WR_8CMD(0x36); // 内存数据访问控制  MX 列地址顺序, MY 行地址顺序 ，MV 行列交换 ，ML 垂直刷新顺序 ,RGB  RGB-BGA顺序
        LCD_ST7735R_WR_8DATA(0x08);//0xc8  0xA8 0x08 0x68

        LCD_ST7735R_WR_8CMD(0x2a);
        LCD_ST7735R_WR_8DATA(0x00);
        LCD_ST7735R_WR_8DATA(0x02);
        LCD_ST7735R_WR_8DATA(0x00);
        LCD_ST7735R_WR_8DATA(0x81);

        LCD_ST7735R_WR_8CMD(0x2B);
        LCD_ST7735R_WR_8DATA(0x00);
        LCD_ST7735R_WR_8DATA(0x03);
        LCD_ST7735R_WR_8DATA(0x00);
        LCD_ST7735R_WR_8DATA(0x82);

        st7735r_h   = ST7735R_H;
        st7735r_w   = ST7735R_W;
        break;
    case 3:
        LCD_ST7735R_WR_8CMD(0x36); // 内存数据访问控制  MX 列地址顺序, MY 行地址顺序 ，MV 行列交换 ，ML 垂直刷新顺序 ,RGB  RGB-BGA顺序
        LCD_ST7735R_WR_8DATA(0x68);//0xc8  0xA8 0x08 0x68

        LCD_ST7735R_WR_8CMD(0x2a);
        LCD_ST7735R_WR_8DATA(0x00);
        LCD_ST7735R_WR_8DATA(0x03);
        LCD_ST7735R_WR_8DATA(0x00);
        LCD_ST7735R_WR_8DATA(0x82);

        LCD_ST7735R_WR_8CMD(0x2B);
        LCD_ST7735R_WR_8DATA(0x00);
        LCD_ST7735R_WR_8DATA(0x00);
        LCD_ST7735R_WR_8DATA(0x00);
        LCD_ST7735R_WR_8DATA(128);

        st7735r_h   = ST7735R_W;
        st7735r_w   = ST7735R_H;
        break;
    default:
        break;
    }

}

/*!
 *  @brief      设置 ST7735R 开窗
 *  @param      site        左上角坐标位置
 *  @param      size        开窗大小
 *  @since      v5.0
 */
void LCD_ST7735R_ptlon(Site_t site, Size_t size)
{

    if(st7735r_dir&0x01)
    {
        site.x += 32;     //液晶需要偏移一下，避免四周看不到的行
        //site.y += 2;
    }
    else
    {
        //site.x += 2;     //液晶需要偏移一下，避免四周看不到的行
        site.y += 32;
    }

    LCD_ST7735R_WR_8CMD(0x2a);   //Partial Mode On  局部模式
    LCD_ST7735R_WR_8DATA((uint8_t)(site.x >> 8)); //高8位 Sx
    LCD_ST7735R_WR_8DATA((uint8_t)site.x);   //低8位 Sx
    LCD_ST7735R_WR_8DATA((uint8_t)((site.x + size.W - 1) >> 8));
    LCD_ST7735R_WR_8DATA((uint8_t)(site.x + size.W - 1));

    LCD_ST7735R_WR_8CMD(0x2B);//Row Address Set  行地址设置
    LCD_ST7735R_WR_8DATA((uint8_t)(site.y >> 8));
    LCD_ST7735R_WR_8DATA((uint8_t)site.y);
    LCD_ST7735R_WR_8DATA((uint8_t)((site.y + size.H - 1) >> 8));
    LCD_ST7735R_WR_8DATA((uint8_t)(site.y + size.H - 1));

}

/*!
 *  @brief      获取 ST7735R 高度
 *  @return     ILI9341 高度
 *  @since      v5.0
 */
uint16_t ST7735R_get_h(void)
{
    return st7735r_h;
}

/*!
 *  @brief      获取 ST7735R 宽度
 *  @return     ILI9341 宽度
 *  @since      v5.0
 */
uint16_t ST7735R_get_w(void)
{
    return st7735r_w;
}

/*!
 *  @brief      获取 ST7735R 显示方向
 *  @return     ST7735R 方向
 *  @since      v5.0
 */
uint8_t ST7735R_get_dir(void)
{
    return st7735r_dir;
}




